## main/Kconfig.projbuild
```kconfig
menu "Herdr Panel Configuration"

    config HERDR_WIFI_SSID
        string "WiFi SSID (default)"
        default "YOUR_SSID"
        help
            Placeholder only. The device enters provisioning mode when
            NVS has no real SSID. Values stored in NVS override this.

    config HERDR_WIFI_PASSWORD
        string "WiFi password (default)"
        default "YOUR_PASSWORD"
        help
            Placeholder only. Never treated as a configured credential.

    config HERDR_BACKEND_HOST
        string "gateway host (default)"
        default "192.168.1.100"
        help
            Host name or IP of the herdr-restful panel gateway.

    config HERDR_BACKEND_PORT
        int "gateway port (default)"
        range 1 65535
        default 8080
        help
            Port of the panel gateway (/api/v1/panel).

    config HERDR_POLL_INTERVAL_MS
        int "Overview poll interval (ms)"
        range 1000 60000
        default 3000
        help
            Short-poll interval for GET /api/v1/panel/overview.
            Detail is polled separately at 2s.

    config HERDR_DEFAULT_BRIGHTNESS
        int "Default backlight percent"
        range 10 100
        default 45
        help
            UI_DESIGN.md default brightness 45%.

endmenu
```
